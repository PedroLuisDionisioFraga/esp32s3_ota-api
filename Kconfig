## Kconfig
```kconfig
menu "OTA API Configuration"

    config OTA_API_TASK_STACK_SIZE
        int "OTA task stack size (bytes)"
        default 8192
        help
            Stack size of the background task created by ota_api_start_task().
            Used when ota_api_config_t.task_stack_size is 0.

    config OTA_API_TASK_PRIORITY
        int "OTA task priority"
        range 1 24
        default 5
        help
            FreeRTOS priority of the background task created by
            ota_api_start_task(). Used when ota_api_config_t.task_priority is 0.

    config OTA_API_TRIAL_TIMEOUT_S
        int "Trial window before automatic rollback (seconds)"
        range 10 3600
        default 120
        help
            How long ota_api_trial_begin() waits for ota_api_trial_confirm()
            before rolling back to the previous firmware. Used when its
            timeout_s argument is 0.

            This is what keeps an unattended device from being stranded on a
            broken update: long enough for whatever confirms the image to
            react, short enough that a field device recovers on its own.

endmenu
```

## examples/advanced/main/Kconfig.projbuild
```kconfig
menu "Example Configuration"

    config EXAMPLE_DEFAULT_FIRMWARE_UPGRADE_URL
        string "default firmware upgrade url endpoint"
        default "https://192.168.0.3:8070/hello_world.bin"
        help
            URL used by the 'ota' console command when it is called without an
            argument. Any other URL can still be passed at runtime: ota <url>.

    config EXAMPLE_PROGRESS_INTERVAL_MS
        int "Minimum gap between progress reports (ms)"
        range 0 10000
        default 250
        help
            Rate limit for the download progress line. 0 reports every chunk,
            which floods the console on a fast link.

    config EXAMPLE_HTTP_REQUEST_SIZE
        int "Bytes per ranged HTTP request"
        range 1024 262144
        default 65536
        help
            Size of each ranged request used to fetch the image. Smaller values
            recover faster from a dropped connection but add request overhead.

    config EXAMPLE_SKIP_COMMON_NAME_CHECK
        bool "Skip server certificate CN fieldcheck"
        default n
        help
            This allows you to skip the validation of OTA server certificate CN field.

            Not needed with the certificate produced by examples/common/ota_server.py:
            it carries the server IP in subjectAltName, which mbedTLS validates.

endmenu
```

## examples/on_demand/main/Kconfig.projbuild
```kconfig
menu "Example Configuration"

    config EXAMPLE_DEFAULT_FIRMWARE_UPGRADE_URL
        string "default firmware upgrade url endpoint"
        default "https://192.168.0.3:8070/hello_world.bin"
        help
            URL used by the 'ota' console command when it is called without an
            argument. Any other URL can still be passed at runtime: ota <url>.

    config EXAMPLE_SKIP_COMMON_NAME_CHECK
        bool "Skip server certificate CN fieldcheck"
        default n
        help
            This allows you to skip the validation of OTA server certificate CN field.

            Not needed with the certificate produced by examples/common/ota_server.py:
            it carries the server IP in subjectAltName, which mbedTLS validates.

endmenu
```

## examples/rollback/main/Kconfig.projbuild
```kconfig
menu "Example Configuration"

    config EXAMPLE_FIRMWARE_UPGRADE_URL
        string "firmware upgrade url endpoint"
        default "https://192.168.0.3:8070/hello_world.bin"
        help
            URL of server which hosts the firmware
            image.

    config EXAMPLE_SKIP_COMMON_NAME_CHECK
        bool "Skip server certificate CN fieldcheck"
        default n
        help
            This allows you to skip the validation of OTA server certificate CN field.

            Not needed with the certificate produced by examples/common/ota_server.py:
            it carries the server IP in subjectAltName, which mbedTLS validates.

endmenu
```
